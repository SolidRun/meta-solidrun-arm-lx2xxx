## conf/machine/include/lx2160a-clearfog-cx.inc
```bitbake
# select DTBs
KERNEL_DEVICETREE ?= " \
	freescale/fsl-lx2160a-clearfog-cx.dtb \
	freescale/fsl-lx2160a-honeycomb.dtb \
"

# select DPL/DPC (config/lx2160a/LX2160A-<MC_FLAVOUR>/<DPL/DPC>)
# variable consumed in wks files
MC_DPC ?= "clearfog-cx-s1_8-s2_0-dpc.dtb"
MC_DPL ?= "clearfog-cx-s1_8-s2_0-dpl.dtb"

# select RCW
BOOTTYPE ?= "flexspi_nor sd emmc auto"
RCWXSPI ?= "clearfog-cx/rcw_${LX2160A_CPU_SPEED}_${LX2160A_BUS_SPEED}_${LX2160A_DDR_SPEED}_18_5_2_xspi"
RCWSD ?= "clearfog-cx/rcw_${LX2160A_CPU_SPEED}_${LX2160A_BUS_SPEED}_${LX2160A_DDR_SPEED}_18_5_2_sdhc"
RCWEMMC ?= "clearfog-cx/rcw_${LX2160A_CPU_SPEED}_${LX2160A_BUS_SPEED}_${LX2160A_DDR_SPEED}_18_5_2_sdhc"
RCWAUTO ?= "clearfog-cx/rcw_${LX2160A_CPU_SPEED}_${LX2160A_BUS_SPEED}_${LX2160A_DDR_SPEED}_18_5_2_auto"
```

## conf/machine/include/lx2160a-honeycomb.inc
```bitbake
# select DPL/DPC (config/lx2160a/LX2160A-<MC_FLAVOUR>/<DPL/DPC>)
# variable consumed in wks files
MC_DPC ?= "clearfog-cx-s1_8-s2_0-dpc.dtb"
MC_DPL ?= "clearfog-cx-s1_8-s2_0-dpl.dtb"

# select RCW
BOOTTYPE ?= "flexspi_nor sd emmc auto"
RCWXSPI ?= "clearfog-cx/rcw_${LX2160A_CPU_SPEED}_${LX2160A_BUS_SPEED}_${LX2160A_DDR_SPEED}_8_5_2_xspi"
RCWSD ?= "clearfog-cx/rcw_${LX2160A_CPU_SPEED}_${LX2160A_BUS_SPEED}_${LX2160A_DDR_SPEED}_8_5_2_sdhc"
RCWEMMC ?= "clearfog-cx/rcw_${LX2160A_CPU_SPEED}_${LX2160A_BUS_SPEED}_${LX2160A_DDR_SPEED}_8_5_2_sdhc"
RCWAUTO ?= "clearfog-cx/rcw_${LX2160A_CPU_SPEED}_${LX2160A_BUS_SPEED}_${LX2160A_DDR_SPEED}_8_5_2_auto"

# select DTB
UBOOT_FDT ?= "fsl-lx2160a-honeycomb"
UBOOT_FDT_FILE ?= "freescale/fsl-lx2160a-honeycomb.dtb"
```

## conf/machine/include/lx2160acex6-rev2.inc
```bitbake
#@TYPE: Machine
#@NAME: SolidRun LX2160A CEX-6
#@SOC: LSCH3
#@DESCRIPTION: Machine configuration for SolidRun Internal LX2160A Rev 2.0 COM-Express Type 6 Module

MACHINEOVERRIDES =. "lx2160a-cex6:"

DTB_LOAD = "0x90000000"
UBOOT_ENTRYPOINT = "0x80080000"

UBOOT_CONFIG ??= "tfa-secure-boot tfa"
UBOOT_CONFIG[tfa] = "lx2160acex7_tfa_defconfig,,u-boot-dtb.bin"
UBOOT_CONFIG[tfa-secure-boot] = "lx2160ardb_tfa_SECURE_BOOT_defconfig,,u-boot-dtb.bin"

ATF_PLATFORM ?= "lx2160acex6"

LX2160A_BUS_SPEED ?= "700"
LX2160A_CPU_SPEED ?= "2000"
LX2160A_DDR_SPEED ?= "2900"

UEFI_XSPIBOOT ?= "LX2160ARDB_EFI_NORBOOT.fd"

EXTRA_IMAGEDEPENDS += "management-complex mc-utils rcw ls2-phy ddr-phy qoriq-atf"

# select DPL/DPC source (config/lx2160a/LX2160A-<MC_FLAVOUR>)
MC_FLAVOUR ?= "CEX6"

# select rev2 rcw
RCW_FOLDER ?= "lx2160acex6_rev2"
RCW_BOARDS ?= "lx2160acex6_rev2"

# generate sd-bootable wic image
WKS_FILE ?= "lx2160a-bootimg-mmc.wks.in"
```

## conf/machine/include/lx2160acex7.inc
```bitbake
#@TYPE: Machine
#@NAME: SolidRun LX2160A CEX-7
#@SOC: LSCH3
#@DESCRIPTION: Machine configuration for SolidRun LX2160A Rev 1.0 COM-Express Type 7 Module

MACHINEOVERRIDES =. "lx2160a-cex7:"

DTB_LOAD = "0x90000000"
UBOOT_ENTRYPOINT = "0x80080000"

UBOOT_CONFIG ??= "tfa-secure-boot tfa"
UBOOT_CONFIG[tfa] = "lx2160acex7_tfa_defconfig,,u-boot-dtb.bin"
UBOOT_CONFIG[tfa-secure-boot] = "lx2160ardb_tfa_SECURE_BOOT_defconfig,,u-boot-dtb.bin"

ATF_PLATFORM ?= "lx2160acex7"

LX2160A_BUS_SPEED ?= "700"
LX2160A_CPU_SPEED ?= "2000"
LX2160A_DDR_SPEED ?= "2900"

UEFI_XSPIBOOT ?= "LX2160ARDB_EFI_NORBOOT.fd"

EXTRA_IMAGEDEPENDS += "management-complex mc-utils rcw ls2-phy ddr-phy qoriq-atf"

# select DPL/DPC source (config/lx2160a/LX2160A-<MC_FLAVOUR>)
MC_FLAVOUR ?= "CEX7"

RCW_FOLDER ?= "lx2160acex7"
RCW_BOARDS ?= "lx2160acex7 lx2160acex7_rev2"

# generate sd-bootable wic image
WKS_FILE ?= "lx2160a-bootimg-mmc.wks.in"
```

## conf/machine/include/lx2162asom-rev2.inc
```bitbake
#@TYPE: Machine
#@NAME: SolidRun LX2162A SoM
#@SOC: LSCH3
#@DESCRIPTION: Machine configuration for SolidRun LX2162A Rev 2.0 System on Module

MACHINEOVERRIDES =. "lx2162a-som:"

DTB_LOAD = "0x90000000"
UBOOT_ENTRYPOINT = "0x80080000"

UBOOT_CONFIG ??= "tfa-secure-boot tfa"
UBOOT_CONFIG[tfa] = "lx2160acex7_tfa_defconfig,,u-boot-dtb.bin"
UBOOT_CONFIG[tfa-secure-boot] = "lx2160ardb_tfa_SECURE_BOOT_defconfig,,u-boot-dtb.bin"

ATF_PLATFORM ?= "lx2162asom"

LX2160A_BUS_SPEED ?= "650"
LX2160A_CPU_SPEED ?= "2000"
LX2160A_DDR_SPEED ?= "2900"

UEFI_XSPIBOOT ?= "LX2160ARDB_EFI_NORBOOT.fd"

EXTRA_IMAGEDEPENDS += "management-complex mc-utils rcw ls2-phy ddr-phy qoriq-atf"

# select DPL/DPC source (config/lx2162a/LX2162A-<MC_FLAVOUR>)
MC_FLAVOUR ?= "SOM"

# select rev2 rcw
RCW_FOLDER ?= "lx2162asom_rev2"
RCW_BOARDS ?= "lx2162asom_rev2"

# generate sd-bootable wic image
WKS_FILE ?= "lx2160a-bootimg-mmc.wks.in"
```

## conf/machine/lx2160a-rev2-twins-right.conf
```bitbake
#@TYPE: Machine
#@NAME: SolidRun LX2160A Twins Dual (right)
#@SOC: LSCH3
#@DESCRIPTION: Machine configuration for SolidRun LX2160A 2.0 Twins Board in Dual Configuration, right side cpu

LX2160A_DDR_SPEED ?= "2900"

require conf/machine/include/lx216xa-solidrun.inc
require conf/machine/include/lx2160acex7-rev2.inc

# select DPL/DPC (config/lx2160a/LX2160A-<MC_FLAVOUR>/<DPL/DPC>)
# variable consumed in wks files
MC_DPC ?= "twins-s1_8-s2_9-dpc.dtb"
MC_DPL ?= "twins-s1_8-s2_9-dpl.dtb"

# select RCW
BOOTTYPE ?= "auto"
RCWAUTO ?= "twins/rcw_${LX2160A_CPU_SPEED}_${LX2160A_BUS_SPEED}_${LX2160A_DDR_SPEED}_8S_9_2_auto"

# configure ATF
ATF_DISABLE_S5 ?= "1"

# configure U-Boot
UBOOT_FDT ?= "fsl-lx2160a-twins-right"
UBOOT_FDT_FILE ?= "freescale/fsl-lx2160a-twins-right.dtb"
UBOOT_ETHPRIME ?= "DPMAC13@sgmii"
```

## conf/machine/lx2162a-rev2-clearfog.conf
```bitbake
#@TYPE: Machine
#@NAME: SolidRun LX2162A Clearfog
#@SOC: LSCH3
#@DESCRIPTION: Machine configuration for SolidRun LX2162A 2.0 Clearfog Board

require conf/machine/include/lx216xa-solidrun.inc
require conf/machine/include/lx2162asom-rev2.inc

# select DPL/DPC (config/lx2162a/LX2162A-<MC_FLAVOUR>/<DPL/DPC>)
# variable consumed in wks files
MC_DPC ?= "clearfog-s1_3-s2_9-dpc.dtb"
MC_DPL ?= "clearfog-s1_3-s2_9-dpl.dtb"

# select RCW
BOOTTYPE ?= "auto"
RCWAUTO ?= "clearfog/rcw_${LX2160A_CPU_SPEED}_${LX2160A_BUS_SPEED}_${LX2160A_DDR_SPEED}_18_9_0_auto"

# configure ATF
ATF_DISABLE_S5 ?= "1"

# configure U-Boot
UBOOT_FDT ?= "fsl-lx2162a-clearfog"
UBOOT_FDT_FILE ?= "freescale/fsl-lx2162a-clearfog.dtb"
UBOOT_ETHPRIME ?= "DPMAC18@sgmii"
```
