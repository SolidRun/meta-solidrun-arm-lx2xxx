## conf/layer.conf
```bitbake
# We have a conf and classes directory, add to BBPATH
BBPATH .= ":${LAYERDIR}"

# We have recipes-* directories, add to BBFILES
BBFILES += "${LAYERDIR}/recipes-*/*/*.bb \
            ${LAYERDIR}/recipes-*/*/*.bbappend"

BBFILE_COLLECTIONS += "solidrun-lx2xxx"
BBFILE_PATTERN_solidrun-lx2xxx = "^${LAYERDIR}/"
BBFILE_PRIORITY_solidrun-lx2xxx = "15"
LAYERVERSION_solidrun-lx2xxx = "1"
LAYERSERIES_COMPAT_solidrun-lx2xxx = "kirkstone"
```

## conf/machine/lx2160acex7-rev2.conf
```bitbake
#@TYPE: Machine
#@NAME: SolidRun LX2160ACEX7
#@SOC: LSCH3
#@DESCRIPTION: Machine configuration for SolidRun LX2160A 2.0 Com-Express Type 7 Module

require conf/machine/lx2160acex7.conf

RCW_FOLDER ?= "lx2160acex7_rev2"
```

## conf/machine/lx2160acex7.conf
```bitbake
#@TYPE: Machine
#@NAME: SolidRun LX2160ACEX7
#@SOC: LSCH3
#@DESCRIPTION: Machine configuration for SolidRun LX2160A Rev 1.0 Com-Express Type 7 Module

require conf/machine/include/qoriq-arm64.inc
require conf/machine/include/arm/arch-arm64.inc

MACHINEOVERRIDES =. "fsl-lsch3:lx2160a:"

MACHINE_FEATURES += "optee"

KERNEL_CLASSES  = " kernel-fitimage "
KERNEL_IMAGETYPES = "fitImage"

DTB_LOAD = "0x90000000"
UBOOT_ENTRYPOINT = "0x80080000"

UBOOT_CONFIG ??= "tfa-secure-boot tfa"
UBOOT_CONFIG[tfa] = "lx2160acex7_tfa_defconfig,,u-boot-dtb.bin"
UBOOT_CONFIG[tfa-secure-boot] = "lx2160ardb_tfa_SECURE_BOOT_defconfig,,u-boot-dtb.bin"

KERNEL_DEVICETREE ?= " \
	freescale/fsl-lx2160a-clearfog-cx.dtb \
	freescale/fsl-lx2160a-honeycomb.dtb \
"
KERNEL_DEFCONFIG ?= "defconfig"

SERIAL_CONSOLES ?= "115200;ttyS0 115200;ttyS1 115200;ttyAMA0"
SERIAL_CONSOLES_CHECK ?= "${SERIAL_CONSOLES}"

LX2160A_BUS_SPEED ?= "700"
LX2160A_CPU_SPEED ?= "2000"
LX2160A_DDR_SPEED ?= "2900"

UEFI_XSPIBOOT ?= "LX2160ARDB_EFI_NORBOOT.fd"
BOOTTYPE ?= "flexspi_nor sd emmc"
RCWXSPI ?= "clearfog-cx/rcw_${LX2160A_CPU_SPEED}_${LX2160A_BUS_SPEED}_${LX2160A_DDR_SPEED}_8_5_2"
RCWSD ?= "clearfog-cx/rcw_${LX2160A_CPU_SPEED}_${LX2160A_BUS_SPEED}_${LX2160A_DDR_SPEED}_8_5_2"
RCWEMMC ?= "clearfog-cx/rcw_${LX2160A_CPU_SPEED}_${LX2160A_BUS_SPEED}_${LX2160A_DDR_SPEED}_8_5_2"

EXTRA_IMAGEDEPENDS += "management-complex mc-utils rcw ls2-phy ddr-phy uefi qoriq-atf inphi"
USE_VT = "0"

# install the vendor-prefixed dtbs
# Note: must keep the non-prefixed versions in place,
# to ensure bootimg-partition.py does not mess with extlinux.conf fdtdir
IMAGE_BOOT_FILES:append = "${KERNEL_DEVICETREE}"

# select DPL/DPC source (config/lx2160a/LX2160A-CEX7)
MC_FLAVOUR ?= "CEX7"
```
